## common/conf/machine/include/amd-common-configurations.inc
```bitbake
require conf/machine/include/amd-features.inc

POKY_DEFAULT_DISTRO_FEATURES_remove = "wayland"

PREFERRED_PROVIDER_jpeg ?= "jpeg"
PREFERRED_PROVIDER_jpeg-native ?= "jpeg-native"
PREFERRED_VERSION_linux-yocto ?= "4.4%"
PREFERRED_VERSION_libav ?= "9.18"
PREFERRED_PROVIDER_llvm ?= "llvm7"

# Components that depend on LLVM should set versions here
# so we know what needs to be changed/validated as LLVM moves
MESA_LLVM_RELEASE_amd = "7"
CLAMAV_LLVM_RELEASE_amd = "7"

MULTILIBS ?= ""
require conf/multilib.conf

MACHINE_FEATURES += "wifi efi alsa"

# QEMU does not support some of the enhanced instructions available
# on the AMD chips which causes some build time failures.
MACHINE_FEATURES_remove = "qemu-usermode"

MACHINE_EXTRA_RRECOMMENDS += "kernel-modules alsa-utils"
MACHINE_EXTRA_RRECOMMENDS += "${@bb.utils.contains("EXTRA_IMAGE_FEATURES", "graphics", "vdpauinfo", "", d)} grub parted util-linux-blkid"
MACHINE_EXTRA_RRECOMMENDS += "rtc-test watchdog-test spi-test smbus-test gpio-test"
MACHINE_EXTRA_RRECOMMENDS += "amd-wdt amd-spi"
MACHINE_EXTRA_RRECOMMENDS += "${@bb.utils.contains_any("DISTRO", "mel mel-lite", "firmware-wireless", "", d)}"

# Add serial consoles to kernel commandline, these should occur before the tty0
KERNEL_SERIAL_CONSOLE ??= ""
APPEND += "${KERNEL_SERIAL_CONSOLE}"

# Make sure the kernel messages go to the VGA console
APPEND += "console=tty0"

# Set a generic video mode, use gfxpayload=wxh for grub2
GRUB_OPTS_append = ";set gfxpayload=1024x768"

# We use ext4 rootfs normally so give it priority rather than trying other FS first
APPEND += "rootfstype=ext4,ext3,ext2"

APPEND_ADDITIONAL ??= ""
APPEND += "${APPEND_ADDITIONAL}"

EXTRA_OECONF_append_pn-matchbox-panel-2 = " --with-battery=acpi"

# IMAGE_FSTYPES "live" is enabled by default in oe-core which is
# responsible for building both "iso" & "hddimg". Although the 
# right way to specify which ones to build is using NOISO & NOHDD
# vars, there's a specific scenario where Toaster build artifacts
# collection mechanism depends on the IMAGE_FSTYPES variable to
# specify the image types explicitly (See: commit a5b1aa4).
# Also, "iso" doesn't get built even if specified explicitly
# because NOISO = "1" by default (See c787dcd in oe-core).
# Therefore, we do as follows:
IMAGE_FSTYPES += "wic iso"
NOISO = "0"
NOHDD = "1"

WKS_FILES ?= "amd-usbimage.wks"

# Contents of IMAGE_BOOT_FILES are deployed into "amd-usbimage.wks" wic image
IMAGE_BOOT_FILES = " \
        ${EFIIMGDIR}${EFIDIR}/*;EFI/BOOT/ \
        ${EFIIMGDIR}/startup.nsh;startup.nsh \
        ${KERNEL_IMAGETYPE} \
        ${INITRD_IMAGE_LIVE}-${MACHINE}.cpio.gz;initrd \
        ${ROOTFS};rootfs.img \
"

# This makes sure that boot files are deployed before do_image_wic starts execution
do_image_wic[depends] += "${IMAGE_BASENAME}:do_bootimg"

IMAGE_OVERHEAD_FACTOR = "1.1"

IOT_PACKAGES_mel ?= "packagegroup-xmpp \
                     packagegroup-mqtt \
                     packagegroup-ble \
                     packagegroup-http-restful"

MACHINE_FEATURES_append_amdgpu := " ${@bb.utils.contains("EXTRA_IMAGE_FEATURES", "graphics", "x11", "", d)}"
MACHINE_FEATURES_append_radeon := " ${@bb.utils.contains("EXTRA_IMAGE_FEATURES", "graphics", "x11", "", d)}"

# Add common feartures to be supported for all machines here
EXTRA_IMAGE_FEATURES += "amd-misc-pkgs"

# Add the basic features we know these overrides support
EXTRA_IMAGE_FEATURES_append_amdgpu := " ${@bb.utils.contains("EXTRA_IMAGE_FEATURES", "multimedia", "amd-feature-multimedia", "", d)} \
                                        ${@bb.utils.contains_any("EXTRA_IMAGE_FEATURES", "graphics", "amd-feature-graphics", "", d)}"
EXTRA_IMAGE_FEATURES_append_radeon := " ${@bb.utils.contains("EXTRA_IMAGE_FEATURES", "multimedia", "amd-feature-multimedia", "", d)} \
                                        ${@bb.utils.contains_any("EXTRA_IMAGE_FEATURES", "graphics", "amd-feature-graphics", "", d)}"

# Workaround for a MEL related issue
# revert as soon as the fixes are merged
# in the main layer.
dm-initramfs_mel ?= ""
```

## common/conf/machine/include/amd-multimedia.inc
```bitbake
# AMD provides the functionality to build packages with license-restricted
# algorithms or software. Their configuration variables can be set to
# "yes" or "no" in the local.conf file to enable or disable the
# functionality to include them in the build. The option to build these
# packages is NOT enabled in the default configuration. After enabling the
# option to build, when you build your target image, the BitBake utility
# fetches package sources from the canonical upstream location. If you do
# not have an active network connection, your build with these packages
# will fail.
#
# Building packages with license-restricted algorithms or software may add
# proprietary IP or functionality with other restrictions to your output.
# AMD has no connection with or responsibility for such
# license-restricted algorithms or software, and failure to abide by the
# relevant license terms may have legal consequences.
#
# AMD does not distribute or endorse sources for license-restricted
# algorithms or software, and disclaims any liability for their use.

# Using mpv requires the use of license-restricted algorithms
# or software.
INCLUDE_MPV ??= "no"

COMMERCIAL_LIC_FLAGS_MPV = "commercial_mpv commercial_ffmpeg commercial_x264"
LICENSE_FLAGS_WHITELIST_append = "${@' ${COMMERCIAL_LIC_FLAGS_MPV}' if bb.utils.to_boolean('${INCLUDE_MPV}') else ''}"
CORE_IMAGE_EXTRA_INSTALL_append = "${@' mpv' if bb.utils.to_boolean('${INCLUDE_MPV}') else ''}"

# Certain multimedia formats also require license restricted codecs and
# software components which are not included in build by default.
INCLUDE_COMMERCIAL_MULTIMEDIA ??= "no"

COMMERCIAL_LIC_FLAGS_MULTIMEDIA = "\
	commercial_gstreamer1.0-plugins-ugly \
	commercial_gstreamer1.0-libav \
	commercial_mpeg2dec \
	commercial_ffmpeg \
	commercial_x264 \
	commercial_faad2 \
"

LICENSE_FLAGS_WHITELIST_append = "${@' ${COMMERCIAL_LIC_FLAGS_MULTIMEDIA}' if bb.utils.to_boolean('${INCLUDE_COMMERCIAL_MULTIMEDIA}') else ''}"
CORE_IMAGE_EXTRA_INSTALL_append = "${@' packagegroup-multimedia-risky' if bb.utils.to_boolean('${INCLUDE_COMMERCIAL_MULTIMEDIA}') else ''}"

# To fix the following error:
# Missing or unbuildable dependency chain was: ['core-image-sato', 'gstreamer1.0-vaapi', 'gstreamer1.0-plugins-bad', 'faad2']
GSTREAMER_PKGS_remove = "${@' gstreamer1.0-vaapi' if not bb.utils.to_boolean('${INCLUDE_COMMERCIAL_MULTIMEDIA}') else ''}"
```

## common/scripts/lib/wic/canned-wks/amd-usbimage.wks
```
# short-description: Create USB image with files from var IMAGE_BOOT_FILES
# long-description: Creates a USB image with all files in the IMAGE_BOOT_FILES
# var e.g. bootloader, initrd, kernel & rootfs.img.

part /boot --source bootimg-partition --ondisk sda --fstype=vfat --label boot --active --align 1024
```

## meta-amd-bsp/conf/machine/e3000.conf
```bitbake
#@TYPE: Machine
#@NAME: e3000

#@DESCRIPTION: Machine configuration for e3000 systems

PREFERRED_PROVIDER_virtual/kernel ?= "${@bb.utils.contains('RT_KERNEL_AMD', 'yes', "linux-yocto-rt", "linux-yocto", d)}"
PREFERRED_VERSION_linux-yocto ?= "5.4%"
PREFERRED_VERSION_linux-yocto-rt ?= "5.4%"

require conf/machine/include/tune-e3000.inc

# Add machine specific AMD features and feature pkgs here
EXTRA_IMAGE_FEATURES += "amd-feature-networking"
DPDK_PKGS_e3000 = "${@bb.utils.contains("BBFILE_COLLECTIONS", "dpdk", "dpdk dpdk-examples dpdk-test", "", d)}"

include conf/machine/include/amd-common-configurations.inc
include conf/machine/include/amd-customer-configurations.inc

MACHINE_FEATURES_remove = "alsa"
MACHINE_EXTRA_RRECOMMENDS_remove = " rtc-test alsa-utils"

# Setup a getty on all serial ports
SERIAL_CONSOLES = "115200;ttyS4 115200;ttyS5"

# Enable the kernel console on ttyS4/COM0
KERNEL_SERIAL_CONSOLE ?= "console=ttyS4,115200n8"

# Disable the graphical console, no graphics support for now
# this allows the serial console to be used for installation
APPEND_remove="console=tty0"

# Drop features we do not need
DISTRO_FEATURES_remove="opengl x11 alsa pulseaudio"

MACHINEOVERRIDES =. "amd:amdx86:"

# Mask out recipes for packages we do not support for
# e3000 but require under common.
BBMASK = ".*/meta-amd/common/recipes-multimedia/mpv|.*/meta-amd/common/recipes-multimedia/v4l2apps|.*/meta-amd/common/recipes-support/libtinyxml|.*/meta-amd/common/recipes-support/numactl"
```

## meta-amd-bsp/conf/machine/ethanolx.conf
```bitbake
#@TYPE: Machine
#@NAME: ethanolx

#@DESCRIPTION: Machine configuration for ethanolx (i.e. rome & milan) systems

require conf/machine/include/amdx86.inc

# Setup a getty on all serial ports
SERIAL_CONSOLES = "115200;ttyS0"

# Enable the kernel console on ttyS0/COM0
KERNEL_SERIAL_CONSOLE ?= "console=ttyS0,115200n8"
```

## meta-amd-bsp/conf/machine/include/amdx86.inc
```bitbake
PREFERRED_PROVIDER_virtual/kernel ?= "${@bb.utils.contains('RT_KERNEL_AMD', 'yes', "linux-yocto-rt", "linux-yocto", d)}"
PREFERRED_VERSION_linux-yocto ?= "5.10%"
PREFERRED_VERSION_linux-yocto-rt ?= "5.10%"

require conf/machine/include/amd-common-configurations.inc
include conf/machine/include/amd-customer-configurations.inc

# Add machine specific AMD features and feature pkgs here
DPDK_PKGS = "${@bb.utils.contains("BBFILE_COLLECTIONS", "dpdk", "dpdk dpdk-examples dpdk-tools dpdk-module", "", d)}"

MACHINE_FEATURES_remove = "screen alsa"
MACHINE_EXTRA_RRECOMMENDS_remove = " rtc-test alsa-utils"

# Drop features we do not need
DISTRO_FEATURES_remove="opengl x11 alsa pulseaudio"

# Disable the graphical console when machine does not have a screen.
# This allows the serial console to be used for installation.
APPEND_remove="${@bb.utils.contains('MACHINE_FEATURES', 'screen-console', '', 'console=tty0', d)}"

MACHINEOVERRIDES =. "amd:amdx86:"

# Mask out recipes for packages we do not support for
# amdx86 but may be required by others. Use '|' sign
# between the patterns.
BBMASK = "\
.*/meta-amd/common/recipes-support/libtinyxml\
"
```

## meta-amd-bsp/conf/machine/include/ethanolx.inc
```bitbake
require conf/machine/include/x86-base.inc

# Setup a getty on all serial ports
SERIAL_CONSOLES = "115200;ttyS0"

# Enable the kernel console on ttyS0
APPEND += "console=ttyS0,115200n8"

MACHINE_FEATURES += "efi"
```

## meta-amd-bsp/conf/machine/include/fox.inc
```bitbake
# Setup a getty on all serial ports
SERIAL_CONSOLES = "115200;ttyS4"

# Enable the kernel console on ttyS0/COM0
KERNEL_SERIAL_CONSOLE ?= "console=ttyS4,115200n8"
```

## meta-amd-bsp/conf/machine/milan.conf
```bitbake
#@TYPE: Machine
#@NAME: milan

#@DESCRIPTION: Machine configuration for milan systems

require conf/machine/include/amdx86.inc

# Setup a getty on all serial ports
SERIAL_CONSOLES = "115200;ttyS0"

# Enable the kernel console on ttyS0/COM0
KERNEL_SERIAL_CONSOLE ?= "console=ttyS0,115200n8"
```

## meta-amd-bsp/conf/machine/v1000.conf
```bitbake
#@TYPE: Machine
#@NAME: v1000

#@DESCRIPTION: Machine configuration for v1000 systems

require conf/machine/include/amdx86.inc

# Setup a getty on all serial ports
SERIAL_CONSOLES = "115200;ttyS4 115200;ttyS5"

# Enable the kernel console on ttyS4/COM0
KERNEL_SERIAL_CONSOLE ?= "console=ttyS4,115200n8"

# Add machine specific AMD features and feature pkgs here
EXTRA_IMAGE_FEATURES += "amd-feature-networking"
```

## meta-amd-bsp/conf/machine/vermeer.conf
```bitbake
#@TYPE: Machine
#@NAME: vermeer

#@DESCRIPTION: Machine configuration for vermeer systems

require conf/machine/include/tune-zen2.inc
require conf/machine/include/amdx86.inc

# Setup a getty on all serial ports
SERIAL_CONSOLES = "115200;ttyS4 115200;ttyS5"

# Enable the kernel console on ttyS4/COM0
KERNEL_SERIAL_CONSOLE ?= "console=ttyS4,115200n8"

# Add screen-console to enable graphical console as well
MACHINE_FEATURES_append = " screen-console"
```

## meta-amd-distro/conf/distro/poky-amd.conf
```bitbake
require conf/distro/poky.conf

DISTRO = "poky-amd"
DISTRO_NAME = "Poky for AMD"
DISTROOVERRIDES = "${DISTRO}"
TARGET_VENDOR = "-amd"
SDK_VENDOR = "-amdsdk"
MAINTAINER = "Wade Farnsworth <wade_farnsworth@mentor.com>"

DISTRO_FEATURES_BACKFILL_CONSIDERED = "sysvinit"
VIRTUAL-RUNTIME_initscripts = ""
DISTRO_FEATURES_append = " systemd"
VIRTUAL-RUNTIME_init_manager = "systemd"

EXTRA_IMAGE_FEATURES_append = " package-management ssh-server-openssh"
PACKAGE_CLASSES = "package_deb"

DISTRO_EXTRA_RDEPENDS += "connman udev-extraconf"

IMAGE_ROOTFS_EXTRA_SPACE = "51200"

# We want information about package and image contents
INHERIT += "buildhistory"
BUILDHISTORY_COMMIT ?= "1"

# We only support IMAGE_FSTYPES "wic" and "iso"
IMAGE_FSTYPES = "wic wic.bmap iso"

WKS_FILES ?= "amd-usbimage.wks"

# Contents of IMAGE_BOOT_FILES are deployed into "amd-usbimage.wks" wic image
IMAGE_BOOT_FILES = " \
        ${EFIIMGDIR}${EFIDIR}/*;EFI/BOOT/ \
        ${EFIIMGDIR}/startup.nsh;startup.nsh \
        ${KERNEL_IMAGETYPE} \
        ${INITRD_IMAGE_LIVE}-${MACHINE}.cpio.gz;initrd \
        ${ROOTFS};rootfs.img \
"

# This makes sure that boot files are deployed before do_image_wic starts execution
do_image_wic[depends] += "${IMAGE_BASENAME}:do_bootimg"

IMAGE_OVERHEAD_FACTOR = "1.1"
```

## meta-amd-distro/conf/layer.conf
```bitbake
# We have a conf and classes directory, add to BBPATH
BBPATH .= ":${LAYERDIR}"

BBFILE_COLLECTIONS += "amd-distro"
BBFILE_PATTERN_amd-distro := "^${LAYERDIR}/"
BBFILE_PRIORITY_amd-distro = "12"

LAYERSERIES_COMPAT_amd-distro = "warrior"

LAYERDEPENDS_amd-distro = "yocto"
```

## meta-e3000/conf/layer.conf
```bitbake
# We have a conf and classes directory, add to BBPATH
BBPATH .= ":${LAYERDIR}"

# We have a recipes-* directories, add to BBFILES
BBFILES += "${LAYERDIR}/recipes-*/*/*.bb \
	${LAYERDIR}/recipes-*/*/*.bbappend"

BBFILE_COLLECTIONS += "e3000"
BBFILE_PATTERN_e3000 = "^${LAYERDIR}/"
BBFILE_PRIORITY_e3000 = "14"
LAYERSERIES_COMPAT_e3000 = "warrior"

LAYERDEPENDS_e3000 = "amd-bsp"
```
